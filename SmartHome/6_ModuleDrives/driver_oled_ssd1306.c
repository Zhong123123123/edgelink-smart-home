#include "driver_oled_ssd1306.h"

#include <stdio.h>
#include <string.h>
#include "driver_i2c.h"

#define OLED_ADDR             (0x3CU << 1)
#define OLED_WIDTH            128U
#define OLED_PAGES            8U
#define OLED_CMD              0x00U
#define OLED_DATA             0x40U

static uint8_t g_oled_ready;
static uint8_t g_framebuffer[OLED_WIDTH * OLED_PAGES];

static const uint8_t g_font5x7[][5] = {
	{0x00,0x00,0x00,0x00,0x00}, /* space */
	{0x00,0x00,0x5F,0x00,0x00}, /* ! */
	{0x00,0x07,0x00,0x07,0x00}, /* " */
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	{0x61,0x51,0x49,0x45,0x43}, /* Z */
};

static int oled_write(uint8_t control, const uint8_t *data, uint16_t len)
{
	uint8_t buf[17];
	uint16_t pos = 0U;
	uint16_t chunk;

	while (pos < len)
	{
		chunk = (uint16_t)(len - pos);
		if (chunk > 16U)
		{
			chunk = 16U;
		}
		buf[0] = control;
		memcpy(&buf[1], &data[pos], chunk);
		if (Driver_I2C_Write(OLED_ADDR, buf, (uint16_t)(chunk + 1U), 100U) != 0)
		{
			return -1;
		}
		pos += chunk;
	}
	return 0;
}

static int oled_cmd(uint8_t cmd)
{
	return oled_write(OLED_CMD, &cmd, 1U);
}

static void oled_clear_buffer(void)
{
	memset(g_framebuffer, 0, sizeof(g_framebuffer));
}

static void oled_draw_char(uint8_t x, uint8_t page, char ch)
{
	const uint8_t *glyph;
	uint8_t i;

	if (page >= OLED_PAGES || x >= (OLED_WIDTH - 5U))
	{
		return;
	}
	if (ch < ' ' || ch > 'Z')
	{
		ch = ' ';
	}

	glyph = g_font5x7[(uint8_t)ch - ' '];
	for (i = 0; i < 5U; i++)
	{
		g_framebuffer[(page * OLED_WIDTH) + x + i] = glyph[i];
	}
	if ((x + 5U) < OLED_WIDTH)
	{
		g_framebuffer[(page * OLED_WIDTH) + x + 5U] = 0x00U;
	}
}

static void oled_draw_text(uint8_t x, uint8_t page, const char *text)
{
	while (*text != '\0' && x < (OLED_WIDTH - 5U))
	{
		oled_draw_char(x, page, *text);
		x = (uint8_t)(x + 6U);
		text++;
	}
}

static int oled_flush(void)
{
	uint8_t page;
	if (oled_cmd(0xAFU) != 0 || oled_cmd(0xA4U) != 0)
	{
		return -1;
	}

	for (page = 0U; page < OLED_PAGES; page++)
	{
		if (oled_cmd((uint8_t)(0xB0U + page)) != 0 ||
			oled_cmd(0x00U) != 0 ||
			oled_cmd(0x10U) != 0 ||
			oled_write(OLED_DATA, &g_framebuffer[page * OLED_WIDTH], OLED_WIDTH) != 0)
		{
			return -1;
		}
	}
	return 0;
}

static int oled_self_test_blink(void)
{
	uint8_t saved[sizeof(g_framebuffer)];

	memcpy(saved, g_framebuffer, sizeof(g_framebuffer));
	memset(g_framebuffer, 0xFF, sizeof(g_framebuffer));
	if (oled_flush() != 0)
	{
		return -1;
	}
	HAL_Delay(300U);

	memset(g_framebuffer, 0x00, sizeof(g_framebuffer));
	if (oled_flush() != 0)
	{
		return -1;
	}
	HAL_Delay(120U);

	memcpy(g_framebuffer, saved, sizeof(g_framebuffer));
	return oled_flush();
}

int Driver_OLED_Init(void)
{
	static const uint8_t init_cmds[] = {
		0xAE, 0x20, 0x00, 0xB0, 0xC8, 0x00, 0x10, 0x40,
		0x81, 0x7F, 0xA1, 0xA6, 0xA8, 0x3F, 0xA4, 0xD3,
		0x00, 0xD5, 0x80, 0xD9, 0xF1, 0xDA, 0x12, 0xDB,
		0x40, 0x8D, 0x14, 0xAF
	};
	uint8_t i;

	if (Driver_I2C_Init() != 0)
	{
		g_oled_ready = 0U;
		return -1;
	}

	HAL_Delay(100U);
	for (i = 0U; i < sizeof(init_cmds); i++)
	{
		if (oled_cmd(init_cmds[i]) != 0)
		{
			g_oled_ready = 0U;
			return -1;
		}
	}

	oled_clear_buffer();
	if (oled_flush() != 0)
	{
		g_oled_ready = 0U;
		return -1;
	}
	if (oled_self_test_blink() != 0)
	{
		g_oled_ready = 0U;
		return -1;
	}
	printf("[DSP] oled selftest blink ok\r\n");
	g_oled_ready = 1U;
	return g_oled_ready ? 0 : -1;
}

int Driver_OLED_ShowStatus(const DisplayStatus *status)
{
	char line[24];

	if (!g_oled_ready || status == 0)
	{
		return -1;
	}

	oled_clear_buffer();

	snprintf(line, sizeof(line), "T:%4.1fC H:%4.1f", status->temperature, status->humidity);
	oled_draw_text(0U, 0U, line);
	snprintf(line, sizeof(line), "L:%u LED:%s", status->light, status->led_on ? "ON" : "OFF");
	oled_draw_text(0U, 2U, line);
	snprintf(line, sizeof(line), "ALM:%s MODE:%s", status->alarm_on ? "ON" : "OFF", status->mode == 1U ? "AUTO" : "MAN");
	oled_draw_text(0U, 4U, line);
	snprintf(line, sizeof(line), "S:%s GW:%s", status->sensor_valid ? "OK" : "BAD", status->wifi_connected ? "UP" : "DN");
	oled_draw_text(0U, 6U, line);

	return oled_flush();
}
